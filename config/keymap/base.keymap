#include <behaviors.dtsi>
#include <zmk-helpers/helper.h>
#include <dt-bindings/zmk/keys.h>
#include <dt-bindings/zmk/bt.h>
#include <dt-bindings/zmk/outputs.h>


#define BASE        0
#define KOREAN      1
#define NAV         2
#define NUM         3
#define FUNC        4
#define SETTINGS    5
#define WIN_TOGGLE  6
#define WIN_OVERLAY 7
#define WIN_NAV     8
#define WIN_NUM     9
#define WIN_FUNC    10

#define ALL_LAYERS \
  BASE KOREAN NAV NUM FUNC SETTINGS \
  WIN_TOGGLE WIN_OVERLAY WIN_NAV WIN_NUM WIN_FUNC 


#define ___ &trans
#define XXX &none

/*
 * Builds without Bluetooth (ESB halves/dongle, wired boards) have no &bt
 * behavior, so the build matrix passes -DKB_NO_BLE and these become &none.
 */
#ifdef KB_NO_BLE
#define KB_BT_CLEAR    &none
#define KB_BT_SEL(n)   &none
#define KB_OUT_TOG     &none
#define KB_OUT_BLE     &none
#else
#define KB_BT_CLEAR    BT_CLEAR
#define KB_BT_SEL(n)   &bt BT_SEL n
#define KB_OUT_TOG     &out OUT_TOG
#define KB_OUT_BLE     &out OUT_BLE
#endif

/*
 * Shared 34-key layout: positions 0-33 are the same on every keyboard.
 * Boards with more keys define KB_EXTRA_KEYS (one binding per extra position,
 * appended after 33) in config/devices/<device>/<device>.keymap.
 */
#ifndef KB_EXTRA_KEYS
#define KB_EXTRA_KEYS
#endif

#define QUICK_TAP_MS        100
#define TAPPING_TERM_MS     135
#define HRM_TAPPING_TERM_MS 300
#define HRM_QUICK_TAP_MS    100
#define HRM_PRIOR_IDLE_MS   75
#define STICKY_RELEASE_MS   350


#include "custom-behaviors.dtsi"
#include "homerow-mods.dtsi"

#include "combos.dtsi"
#include "homerow-combos.dtsi"


/* macOS is the default. Toggling WIN_TOGGLE overlays the Windows differences. */
ZMK_CONDITIONAL_LAYER(win_base,      WIN_TOGGLE, WIN_OVERLAY)
ZMK_CONDITIONAL_LAYER(win_nav,  NAV  WIN_TOGGLE, WIN_NAV    )
ZMK_CONDITIONAL_LAYER(win_num,  NUM  WIN_TOGGLE, WIN_NUM    )
ZMK_CONDITIONAL_LAYER(win_func, FUNC WIN_TOGGLE, WIN_FUNC   )


#define LAYER(NAME, LT, RT, LM, RM, LB, RB, TH)  ZMK_LAYER(NAME, LT RT LM RM LB RB TH KB_EXTRA_KEYS)

LAYER(Base,
//╭─────────────┬─────────────┬─────────────┬─────────────┬─────────────╮ ╭─────────────┬─────────────┬─────────────┬─────────────┬─────────────╮
		&kp Q         &kp W         &kp F         &kp P         &kp G       ,   &kp J         &kp L         &kp U         &kp Y         &kp SEMI    ,
//├─────────────┼─────────────┼─────────────┼─────────────┼─────────────┤ ├─────────────┼─────────────┼─────────────┼─────────────┼─────────────┤
		&kp A         &kp R         &kp S         &kp T         &kp D       ,   &kp H         &kp N         &kp E         &kp I         &kp O       ,
//├─────────────┼─────────────┼─────────────┼─────────────┼─────────────┤ ├─────────────┼─────────────┼─────────────┼─────────────┼─────────────┤
		&kp Z         &kp X         &kp C         &kp V         &kp B       ,   &kp K         &kp M         &kp COMMA     &kp DOT       &kp SLASH   ,
//╰─────────────┼─────────────┴─────────────┼─────────────┼─────────────┤ ├─────────────┼─────────────┼─────────────┴───────────────────────────╯
																				&lt NAV SPACE &sk LGUI        &sk LSHFT     &mac_lang_num NUM 0
//                                          ╰─────────────┴─────────────╯ ╰─────────────┴─────────────╯
)

LAYER(Korean,
//╭─────────────┬─────────────┬─────────────┬─────────────┬─────────────╮ ╭─────────────┬─────────────┬─────────────┬─────────────┬─────────────╮
		&kp Q         &kp W         &kp E         &kp R         &kp T       ,   &kp Y         &kp U         &kp I         &kp O         &kp SLASH   ,
//├─────────────┼─────────────┼─────────────┼─────────────┼─────────────┤ ├─────────────┼─────────────┼─────────────┼─────────────┼─────────────┤
		&kp A         &kp S         &kp D         &kp F         &kp G       ,   &kp H         &kp J         &kp K         &kp L         &kp P       ,
//├─────────────┼─────────────┼─────────────┼─────────────┼─────────────┤ ├─────────────┼─────────────┼─────────────┼─────────────┼─────────────┤
		&kp Z         &kp X         &kp C         &kp V         &kp B       ,   &kp B         &kp N         &kp M         &kp COMMA     &kp DOT     ,
//╰─────────────┼─────────────┴─────────────┼─────────────┼─────────────┤ ├─────────────┼─────────────┼─────────────┴───────────────────────────╯
																				&lt NAV SPACE &sk LGUI        &sk LSHFT     &mac_lang_num NUM 0
//                                          ╰─────────────┴─────────────╯ ╰─────────────┴─────────────╯
)

#define WIN_CAPTURE &kp LS(LG(S))
LAYER(Nav,
//╭─────────────┬─────────────┬─────────────┬─────────────┬─────────────╮ ╭─────────────┬─────────────┬─────────────┬─────────────┬─────────────╮
		___           &kp LBKT      &lpar_lt      &rpar_gt      &kp RBKT    ,   &kp ESC       &kp TAB       &kp ENTER     &kp BACKSPACE &kp LC(BSPC),
//├─────────────┼─────────────┼─────────────┼─────────────┼─────────────┤ ├─────────────┼─────────────┼─────────────┼─────────────┼─────────────┤
    &kp LSHFT     HRM_LA(SEMI)  HRM_LS(MINUS) HRM_MLC(EQUAL) &kp LCTRL  ,   &kp SPACE     &kp LEFT      &kp DOWN      &kp UP        &kp RIGHT   ,
//├─────────────┼─────────────┼─────────────┼─────────────┼─────────────┤ ├─────────────┼─────────────┼─────────────┼─────────────┼─────────────┤
    ___           &kp SQT       &kp GRAVE     &kp BSLH      ___         ,   WIN_CAPTURE   &kp HOME      &kp PAGE_DOWN &kp PAGE_UP   &kp END     ,
//╰─────────────┼─────────────┴─────────────┼─────────────┼─────────────┤ ├─────────────┼─────────────┼─────────────┴───────────────────────────╯
																							___           ___             ___           ___
//                                          ╰─────────────┴─────────────╯ ╰─────────────┴─────────────╯
)

LAYER(Num,
//╭─────────────┬─────────────┬─────────────┬─────────────┬─────────────╮ ╭─────────────┬─────────────┬─────────────┬─────────────┬─────────────╮
    XXX           &kp N7        &kp N8        &kp N9        &kp ENTER   ,   ___           ___           ___           ___           ___         ,
//├─────────────┼─────────────┼─────────────┼─────────────┼─────────────┤ ├─────────────┼─────────────┼─────────────┼─────────────┼─────────────┤
    &kp N0        &kp N4        &kp N5        &kp N6        &kp DOT     ,   &kp RCTRL     &kp RGUI      &kp RSHFT     &kp RALT      &sl FUNC    ,
//├─────────────┼─────────────┼─────────────┼─────────────┼─────────────┤ ├─────────────┼─────────────┼─────────────┼─────────────┼─────────────┤
    XXX           &kp N1        &kp N2        &kp N3        XXX         ,   ___           ___           ___           ___           ___         ,
//╰─────────────┼─────────────┴─────────────┼─────────────┼─────────────┤ ├─────────────┼─────────────┼─────────────┴───────────────────────────╯
																							___            ___            ___           ___
//                                          ╰─────────────┴─────────────╯ ╰─────────────┴─────────────╯
)


LAYER(Func,
//╭─────────────┬─────────────┬─────────────┬─────────────┬─────────────╮ ╭─────────────┬─────────────┬─────────────┬─────────────┬─────────────╮
	 	___           &kp F7        &kp F8       &kp F9         &kp F12     ,   ___           ___           ___           ___           ___  	      ,
//├─────────────┼─────────────┼─────────────┼─────────────┼─────────────┤ ├─────────────┼─────────────┼─────────────┼─────────────┼─────────────┤
		___           &kp F4        &kp F5        &kp F6        &kp F11     ,   ___           ___           ___           ___           ___  	      ,
//├─────────────┼─────────────┼─────────────┼─────────────┼─────────────┤ ├─────────────┼─────────────┼─────────────┼─────────────┼─────────────┤
		___           &kp F1        &kp F2        &kp F3        &kp F10     ,   ___           ___           ___           ___           ___  	      ,
//╰─────────────┼─────────────┴─────────────┼─────────────┼─────────────┤ ├─────────────┼─────────────┼─────────────┴───────────────────────────╯
																							___           ___             ___           ___
//                                          ╰─────────────┴─────────────╯ ╰─────────────┴─────────────╯
)



#define TOGGLE_WIN &tog WIN_TOGGLE
#define BOOTLOADER &ht_bootloader 0 0
#define BT_CLEAR   &ht_bt_clr 0 0
LAYER(Settings,
//╭─────────────┬─────────────┬─────────────┬─────────────┬─────────────╮ ╭─────────────┬─────────────┬─────────────┬─────────────┬─────────────╮
		&bootloader   KB_OUT_TOG  KB_OUT_BLE &out OUT_USB  XXX         ,   XXX           XXX           XXX           XXX           &tog KOREAN ,
//├─────────────┼─────────────┼─────────────┼─────────────┼─────────────┤ ├─────────────┼─────────────┼─────────────┼─────────────┼─────────────┤
		KB_BT_CLEAR KB_BT_SEL(3) KB_BT_SEL(4) KB_BT_SEL(5) XXX   ,   XXX           TOGGLE_WIN    XXX           XXX           BOOTLOADER  ,
//├─────────────┼─────────────┼─────────────┼─────────────┼─────────────┤ ├─────────────┼─────────────┼─────────────┼─────────────┼─────────────┤
		XXX           KB_BT_SEL(0) KB_BT_SEL(1) KB_BT_SEL(2) XXX   ,   XXX           XXX           XXX           XXX           XXX         ,
//╰─────────────┼─────────────┴─────────────┼─────────────┼─────────────┤ ├─────────────┼─────────────┼─────────────┴───────────────────────────╯
																							XXX           XXX             XXX           XXX
//                                          ╰─────────────┴─────────────╯ ╰─────────────┴─────────────╯
)

/*====LAYERS=>=WINDOWS==============================================================*/
LAYER(WinToggle,
//╭─────────────┬─────────────┬─────────────┬─────────────┬─────────────╮ ╭─────────────┬─────────────┬─────────────┬─────────────┬─────────────╮
		___           ___           ___           ___           ___        	,   ___           ___           ___           ___           ___  	      ,
//├─────────────┼─────────────┼─────────────┼─────────────┼─────────────┤ ├─────────────┼─────────────┼─────────────┼─────────────┼─────────────┤
		___           ___           ___           ___           ___        	,   ___           ___           ___           ___           ___   	    ,
//├─────────────┼─────────────┼─────────────┼─────────────┼─────────────┤ ├─────────────┼─────────────┼─────────────┼─────────────┼─────────────┤
		___           ___           ___           ___           ___        	,   ___           ___           ___           ___           ___     	  ,
//╰─────────────┼─────────────┴─────────────┼─────────────┼─────────────┤ ├─────────────┼─────────────┼─────────────┴───────────────────────────╯
																							___           ___             ___           ___
//                                          ╰─────────────┴─────────────╯ ╰─────────────┴─────────────╯
)

LAYER(WinOverlay,
//╭─────────────┬─────────────┬─────────────┬─────────────┬─────────────╮ ╭─────────────┬─────────────┬─────────────┬─────────────┬─────────────╮
		___           ___           ___           ___           ___  	      ,   ___           ___           ___           ___           ___         ,
//├─────────────┼─────────────┼─────────────┼─────────────┼─────────────┤ ├─────────────┼─────────────┼─────────────┼─────────────┼─────────────┤
		___           ___           ___           ___           ___  	      ,   ___           ___           ___           ___           ___         ,
//├─────────────┼─────────────┼─────────────┼─────────────┼─────────────┤ ├─────────────┼─────────────┼─────────────┼─────────────┼─────────────┤
    ___           ___           ___           ___           ___     	  ,   ___           ___           ___           ___           ___         ,
//╰─────────────┼─────────────┴─────────────┼─────────────┼─────────────┤ ├─────────────┼─────────────┼─────────────┴───────────────────────────╯
																							___           &sk LCTRL       ___           &lang_num NUM 0
//                                          ╰─────────────┴─────────────╯ ╰─────────────┴─────────────╯
)

LAYER(WinNav,
//╭─────────────┬─────────────┬─────────────┬─────────────┬─────────────╮ ╭─────────────┬─────────────┬─────────────┬─────────────┬─────────────╮
    ___           ___           ___           ___           ___         ,   ___           ___           ___           ___           &kp DEL     ,
//├─────────────┼─────────────┼─────────────┼─────────────┼─────────────┤ ├─────────────┼─────────────┼─────────────┼─────────────┼─────────────┤
    ___           ___           ___           HRM_LC(EQUAL) &kp LGUI    ,   ___           ___           ___           ___           ___         ,
//├─────────────┼─────────────┼─────────────┼─────────────┼─────────────┤ ├─────────────┼─────────────┼─────────────┼─────────────┼─────────────┤
    ___           ___           ___           ___           ___     	  ,   ___           ___           ___           ___           ___         ,
//╰─────────────┼─────────────┴─────────────┼─────────────┼─────────────┤ ├─────────────┼─────────────┼─────────────┴───────────────────────────╯
																							___           ___             ___           ___
//                                          ╰─────────────┴─────────────╯ ╰─────────────┴─────────────╯
)

LAYER(WinNum,
//╭─────────────┬─────────────┬─────────────┬─────────────┬─────────────╮ ╭─────────────┬─────────────┬─────────────┬─────────────┬─────────────╮
		___           ___           ___           ___           ___     	  ,   ___           ___           ___           ___           ___         ,
//├─────────────┼─────────────┼─────────────┼─────────────┼─────────────┤ ├─────────────┼─────────────┼─────────────┼─────────────┼─────────────┤
		___           ___           ___           ___           ___   	    ,   &kp RGUI      &kp RCTRL     ___           ___           ___         ,
//├─────────────┼─────────────┼─────────────┼─────────────┼─────────────┤ ├─────────────┼─────────────┼─────────────┼─────────────┼─────────────┤
    ___           ___           ___           ___           ___     	  ,   ___           ___           ___           ___           ___         ,
//╰─────────────┼─────────────┴─────────────┼─────────────┼─────────────┤ ├─────────────┼─────────────┼─────────────┴───────────────────────────╯
																							___           ___             ___           ___
//                                          ╰─────────────┴─────────────╯ ╰─────────────┴─────────────╯
)

LAYER(WinFunc,
//╭─────────────┬─────────────┬─────────────┬─────────────┬─────────────╮ ╭─────────────┬─────────────┬─────────────┬─────────────┬─────────────╮
		___           ___           ___           ___           ___  	      ,   ___           ___           ___           ___           ___         ,
//├─────────────┼─────────────┼─────────────┼─────────────┼─────────────┤ ├─────────────┼─────────────┼─────────────┼─────────────┼─────────────┤
		___           ___           ___           ___           ___   	    ,   ___           ___           ___           ___           ___         ,
//├─────────────┼─────────────┼─────────────┼─────────────┼─────────────┤ ├─────────────┼─────────────┼─────────────┼─────────────┼─────────────┤
		___           ___           ___           ___           ___     	  ,   ___           ___           ___           ___           ___         ,
//╰─────────────┼─────────────┴─────────────┼─────────────┼─────────────┤ ├─────────────┼─────────────┼─────────────┴───────────────────────────╯
																							___           ___             ___           ___
//                                          ╰─────────────┴─────────────╯ ╰─────────────┴─────────────╯
)
