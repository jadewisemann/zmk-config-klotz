/*
 * ESB link addresses for klotz. Left half, right half and dongle all use this
 * file. Each keyboard gets its own addresses so two ESB keyboards (or their
 * dongles) never talk to each other.
 */
/ {
    esb_split: esb_split {
        compatible = "zmk,esb-split";
        base-addr-0 = <0x8D 0x4B 0xA7 0x31>;
        base-addr-1 = <0x6C 0x92 0xE5 0x47>;
        addr-prefix = <0x2A 0x53 0x71 0x96 0xB4 0xC8 0xDD 0xF1>;
    };
};
