/*
 * ESB link addresses for urchin. Left half, right half and dongle all use this
 * file. Each keyboard gets its own addresses so two ESB keyboards (or their
 * dongles) never talk to each other.
 */
/ {
    esb_split: esb_split {
        compatible = "zmk,esb-split";
        base-addr-0 = <0x3E 0x91 0xC4 0x5B>;
        base-addr-1 = <0x7A 0x26 0xD3 0x48>;
        addr-prefix = <0x1B 0x37 0x4E 0x62 0x8C 0xA5 0xB9 0xE3>;
    };
};
